## arch/arm/mach-rockchip/rk3588/Kconfig
```kconfig
if ROCKCHIP_RK3588

config TARGET_EVB_RK3588
	bool "EVB_RK3588"
	select BOARD_LATE_INIT
	help
	  RK3588 EVB is a evaluation board for Rockchp RK3588.

config SYS_SOC
	default "rockchip"

config SYS_MALLOC_F_LEN
	default 0x400

config TARGET_RK3588_AXON
	bool "Vicharak RK3588 Axon board"
	select BOARD_LATE_INIT
	help
	  The Axon is a Single Board Computer (SBC) designed by Vicharak,
	  which is powered by the RK3588 processor.

	  The board features a dual-channel DDR4 RAM configuration
	  with a total capacity of 8GB, as well as storage options
	  including SATA, NVMe, eMMC, and SDMMC.

	  Other notable features include a 1GBps LAN connection,
	  RTL8852BS-based WiFi and Bluetooth module,
	  ES8388 Audio codec support, MIPI CSI RX x 2,
	  MIPI DCPHY RX x 2, MIPI DCPHY TX x 2 and 3 x PCIe 2.0 and 1 x 3.0 slots.

	  The Axon also includes a variety of header pins
	  for UART, I2C, SPI, and SARADC connectivity,
	  as well as micro HDMI ports and
	  2 x USB Type-C connectors for power delivery, 3.1 USB and DP.

config TARGET_RK3588_AXON_CM
	bool "Vicharak RK3588 Axon Computer Module board"
	select BOARD_LATE_INIT
	help
	The AXON-CM is a compact, high-performance System-on-Module (SoM)
	based on the Rockchip RK3588 octa-core processor, featuring world’s
        first integrated on-board Wi-Fi and Bluetooth module.

        Designed in a space-efficient 72 mm × 50 mm form factor with
        four 120-pin connectors, it delivers powerful AI computing with a 6 TOPS NPU,
        support for 8K video, and high-speed LPDDR5 memory.
        Ideal for edge AI, multimedia, and industrial applications,the AXON-CM delivers
        rich I/O, robust performance and advanced connectivity in a compact footprint.

source board/rockchip/evb_rk3588/Kconfig
source board/vicharak/rk3588_axon/Kconfig
source board/vicharak/rk3588_axon_cm/Kconfig

endif
```

## board/vicharak/rk3588_axon_cm/Kconfig
```kconfig
if TARGET_RK3588_AXON_CM

config SYS_BOARD
	default "rk3588_axon_cm"

config SYS_VENDOR
	default "vicharak"

config SYS_CONFIG_NAME
	default "rk3588_axon_cm"

config BOARD_SPECIFIC_OPTIONS
	def_bool y

endif
```
